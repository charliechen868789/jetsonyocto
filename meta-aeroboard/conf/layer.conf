## meta-aeroboard/wic/aeroboard-sd.wks
```
part /boot --source bootimg-partition --ondisk mmcblk0 --fstype=vfat --label boot --active --align 4 --size 200M
part / --source rootfs --ondisk mmcblk0 --fstype=ext4 --label rootfs --align 4 --size 6G
bootloader --ptable msdos
```
